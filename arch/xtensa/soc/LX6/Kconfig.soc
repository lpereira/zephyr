## arch/xtensa/soc/LX6/Kconfig.soc
```kconfig
# Copyright (c) 2017 Intel Corporation
# SPDX-License-Identifier: Apache-2.0

config SOC_LX6
	bool "LX6"
```

## arch/xtensa/soc/esp32/Kconfig.defconfig
```kconfig
# Kconfig - XTENSA board configuration
#
# Copyright (c) 2016 Open-RnD Sp. z o.o.
# Copyright (c) 2016 Cadence Design Systems, Inc.
# SPDX-License-Identifier: Apache-2.0

if SOC_ESP32

config SOC
	string
	default esp32

config IRQ_OFFLOAD_INTNUM
	default 7

endif
```

## boards/xtensa/esp32/Kconfig.board
```kconfig
# Kconfig - XTENSA board configuration
#
# Copyright (c) 2016 Cadence Design Systems, Inc.
# SPDX-License-Identifier: Apache-2.0

config BOARD_ESP32
	bool "Espressif ESP32 Development Board"
	depends on XTENSA
```

## boards/xtensa/esp32/Kconfig.defconfig
```kconfig
# Kconfig - STM32 MINI A15 board configuration
#
# Copyright (c) 2016 Cadence Design Systems, Inc.
# SPDX-License-Identifier: Apache-2.0

if BOARD_ESP32

config BOARD
	default esp32

endif # BOARD_ESP32
```

## boards/xtensa/esp32/esp32_defconfig
```kconfig
CONFIG_MAIN_STACK_SIZE=2048
CONFIG_IPM_CONSOLE_STACK_SIZE=2048
CONFIG_XTENSA=y
CONFIG_SOC_LX6=y
CONFIG_BOARD_ESP32=y
CONFIG_CONSOLE=y
CONFIG_BOARD_XTENSA=y
```
